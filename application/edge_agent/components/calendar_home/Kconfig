## application/edge_agent/components/calendar_home/Kconfig
```kconfig
menu "Calendar Home"

config CALENDAR_HOME_ENABLE_RTC
    bool "Enable PCF85063 RTC fallback"
    default y

config CALENDAR_HOME_ENABLE_SHTC3
    bool "Enable SHTC3 indoor temperature and humidity"
    default y

config CALENDAR_HOME_I2C_PORT
    int "Calendar sensor I2C port"
    default 0
    range 0 1

config CALENDAR_HOME_REFRESH_MS
    int "Calendar refresh interval in milliseconds"
    default 30000
    range 1000 3600000

endmenu
```

## components/voice_assistant_sdk/Kconfig
```kconfig
menu "Voice Assistant SDK"

config VOICE_ASSISTANT_ENABLE
    bool "Enable voice assistant SDK"
    default y
    help
        Enable the reusable voice assistant component and calendar integration.

config VOICE_ASSISTANT_BACKEND_URL
    string "Voice assistant backend WebSocket URL"
    default ""
    depends on VOICE_ASSISTANT_ENABLE
    help
        URL of the trusted backend that proxies cloud model providers.

config VOICE_ASSISTANT_DEVICE_ID
    string "Voice assistant device id"
    default "esp32-calendar"
    depends on VOICE_ASSISTANT_ENABLE

config VOICE_ASSISTANT_MANUAL_TRIGGER
    bool "Enable manual listen trigger"
    default y
    depends on VOICE_ASSISTANT_ENABLE

config VOICE_ASSISTANT_WAKE_WORD
    bool "Enable local wake word"
    default n
    depends on VOICE_ASSISTANT_ENABLE
    help
        Enable the wake-word listening path. A concrete local recognizer still
        needs to be selected below, or a backend must handle recognition.

config VOICE_ASSISTANT_WAVESHARE_CODEC_PORT
    bool "Enable Waveshare ES7210/ES8311 audio port"
    default n
    depends on VOICE_ASSISTANT_ENABLE
    help
        Build the Waveshare ESP32-S3-RLCD-4.2 codec port using the vendored
        codec_board implementation. This requires the esp_codec_dev component.

config VOICE_ASSISTANT_ESP_SR_LOCAL_RECOGNIZER
    bool "Enable ESP-SR local wake and command recognizer"
    default n
    depends on VOICE_ASSISTANT_ENABLE && VOICE_ASSISTANT_WAKE_WORD
    help
        Build an offline ESP-SR MultiNet recognizer. This supports wake phrase
        plus a finite command set, not arbitrary dictation ASR. It requires the
        esp-sr component and compatible model partition/assets.

config VOICE_ASSISTANT_WAKE_PHRASE_PINYIN
    string "Wake phrase pinyin"
    default "xiao wang xiao wang"
    depends on VOICE_ASSISTANT_ESP_SR_LOCAL_RECOGNIZER

config VOICE_ASSISTANT_WAKE_PHRASE_TEXT
    string "Wake phrase display text"
    default "小王小王"
    depends on VOICE_ASSISTANT_ESP_SR_LOCAL_RECOGNIZER

config VOICE_ASSISTANT_DEFAULT_VOLUME
    int "Default speaker volume"
    default 70
    range 0 100
    depends on VOICE_ASSISTANT_ENABLE

endmenu
```

## main/Kconfig.projbuild
```kconfig
menu "ESP32 Calendar"

config CALENDAR_WIFI_SSID
    string "Wi-Fi SSID"
    default ""
    help
        Wi-Fi network name used by the calendar firmware for SNTP time sync.
        Leave empty to skip Wi-Fi startup.

config CALENDAR_WIFI_PASSWORD
    string "Wi-Fi password"
    default ""
    help
        Wi-Fi password for CALENDAR_WIFI_SSID. Leave empty for open networks.

config CALENDAR_SNTP_SERVER
    string "SNTP server"
    default "ntp.aliyun.com"
    help
        SNTP server used to set system time and refresh the PCF85063 RTC.

config CALENDAR_DUMP_RLCD_FRAME
    bool "Dump the first RLCD frame to the serial log"
    default n
    help
        Emit the first ST7305 landscape 1bpp frame buffer as hex chunks.
        This is intended for render debugging only and should stay disabled
        during normal firmware runs.

endmenu
```

## sdkconfig.defaults
```kconfig
# Target: Waveshare ESP32-S3-RLCD-4.2 / ESP32-S3-WROOM-1-N16R8
CONFIG_IDF_TARGET="esp32s3"

# Flash / PSRAM profile from board specs: 16MB Flash + 8MB PSRAM
CONFIG_ESPTOOLPY_FLASHSIZE_16MB=y
CONFIG_SPIRAM=y
CONFIG_SPIRAM_MODE_OCT=y
CONFIG_SPIRAM_SPEED_80M=y
CONFIG_SPIRAM_USE_MALLOC=y

# USB Serial/JTAG logs are convenient for ESP32-S3 boards over Type-C
CONFIG_ESP_CONSOLE_USB_SERIAL_JTAG=y
CONFIG_ESP_CONSOLE_SECONDARY_NONE=y

# LVGL v8 display profile for the 400x300 monochrome RLCD panel
CONFIG_LV_CONF_SKIP=y
CONFIG_LV_COLOR_DEPTH_16=y
CONFIG_LV_MEM_SIZE_KILOBYTES=64
CONFIG_LV_USE_LOG=y
CONFIG_LV_FONT_MONTSERRAT_12=y
CONFIG_LV_FONT_MONTSERRAT_14=y
CONFIG_LV_FONT_MONTSERRAT_16=y
CONFIG_LV_FONT_MONTSERRAT_20=y
CONFIG_LV_FONT_MONTSERRAT_28=y
CONFIG_LV_FONT_MONTSERRAT_48=y
CONFIG_LV_FONT_DEFAULT_MONTSERRAT_20=y
CONFIG_LV_USE_LABEL=y
CONFIG_LV_USE_BTN=y
CONFIG_LV_BUILD_EXAMPLES=n
CONFIG_LV_USE_DEMO_WIDGETS=n
CONFIG_LV_USE_DEMO_KEYPAD_AND_ENCODER=n
CONFIG_LV_USE_DEMO_BENCHMARK=n
CONFIG_LV_USE_DEMO_STRESS=n
CONFIG_LV_USE_DEMO_MUSIC=n
```
